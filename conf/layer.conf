## conf/layer.conf
```bitbake
# We have a conf and classes directory, add to BBPATH
BBPATH .= ":${LAYERDIR}"

# We have recipes-* directories, add to BBFILES
BBFILES += "${LAYERDIR}/recipes-*/*/*.bb \
            ${LAYERDIR}/recipes-*/*/*/*.bbappend \
            ${LAYERDIR}/recipes-*/*/*.bbappend"

BBFILE_COLLECTIONS += "meta-pi"
BBFILE_PATTERN_meta-pi := "^${LAYERDIR}/"
BBFILE_PRIORITY_meta-pi = "10"

LAYERDEPENDS_meta-pi = "core"
LAYERSERIES_COMPAT_meta-pi = "mickledore"


# This sets the default machine RPi if no other machine is selected:
MACHINE ?= "raspberrypi3-64"
#Prefix to the resulting deployable tarball name
#export IMAGE_BASENAME = "Reference-Minimal-Image"
#MACHINE_NAME ?= "${MACHINE}"
#IMAGE_NAME = "${MACHINE_NAME}_${IMAGE_BASENAME}"

SSTATE_DIR = "${TOPDIR}/sstate-cache"
DL_DIR = "${TOPDIR}/downloads"
TMPDIR = "${TOPDIR}/tmp"
  
# this is a smarter image format that can save alot of time when burning a SD card.
# use balena etcher or bmaptool for faster results
IMAGE_FSTYPES ?= "wic.bz2 wic wic.bmap"

# the recomended formats are ipk (which uses opkg) or rpm (which uses dnf)
# choose one format so that the package repository does not waste space saving package in multiple formats
PACKAGE_CLASSES = "package_ipk"

# check /opt/yocto/dunfell/src/poky/meta/recipes-kernel/linux/ for options like: "linux-yocto-rt"
#PREFERRED_PROVIDER_virtual/kernel = "linux-raspberrypi-rt"
#PREFERRED_PROVIDER_virtual/kernel = "linux-yocto"

# removing unsued packages
# https://stackoverflow.com/questions/28765494/yocto-minimal-image-with-package-management
# check the file for the list of features that can be excluded
# /opt/yocto/dunfell/src/poky/meta/recipes-core/packagegroups/packagegroup-base.bb:
IMAGE_FEATURE:remove = " x11 alsa touchscreen bluetooth opengl wayland apm ext2 nfs phone nfc ppp"

# enable uart serial terminal
# check https://meta-raspberrypi.readthedocs.io/en/latest/extra-build-config.html for additional parameters
ENABLE_UART = "1"

INIT_MANAGER = "systemd"

# used to check the size of the image, the dependency, size of each package, etc
# check the directory build/buildhistory/images/raspberrypi3_64/glibc/core-image-base/
INHERIT += "buildhistory"
BUILDHISTORY_COMMIT = "1"

# example of how to add something to the bootloaded 
#do_deploy_append() {
#    # Enable i2c by default
#    echo "dtparam=i2c_arm=on" >> ${DEPLOYDIR}/bcm2835-bootfiles/config.txt
#}

LICENSE_FLAGS_ACCEPTED = "synaptics-killswitch"
```
